/* SPDX-License-Identifier: GPL-2.0 */

#include "msm-audio-overlay.dtsi"
#include "msm-pm660-overlay.dtsi"
#include "msm-pm660l-overlay.dtsi"
#include "sdm630-camera-overlay.dtsi"
#include "sdm630-cdp-overlay.dtsi"
#include "sdm630-regulator-overlay.dtsi"
#include "sdm660-audio-overlay.dtsi"
#include "sdm660-camera-overlay.dtsi"
#include "sdm660-cdp-overlay.dtsi"
#include "sdm660-common-overlay.dtsi"
#include "sdm660-lpi-overlay.dtsi"
#include "sdm660-pm-overlay.dtsi"
#include "sdm660-regulator-overlay.dtsi"
#include "sdm660-wcd-overlay.dtsi"
