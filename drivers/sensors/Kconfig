## drivers/sensors/Kconfig
```kconfig
config SENSORS_SSC
	bool "Enable Sensors Driver Support for SSC"
	help
	  Add support for sensors SSC driver.
	  This driver is used for exercising sensors use case,
	  time syncing with ADSP clock.

config SENSORS_CLASS
	bool "Sensors Class Support"
	help
	  This option enables the sensor sysfs class in /sys/class/sensors.
	  You'll need this to do anything useful with sensors.

	  If unsure, say N.

config INPUT_STK3321
	tristate "STK STK3321 alsps sensor"
	depends on MACH_ASUS_X00TD && I2C
	select SENSORS_CLASS
	help
	  Say Y here to enable the STK3321 ALSPS Sensor.

config INPUT_STK3335
	tristate "STK STK3335 alsps sensor"
	depends on MACH_ASUS_X01BD && I2C
	select SENSORS_CLASS
	help
	  Say Y here to enable the STK3335 ALSPS Sensor.

config INPUT_CM3323E
	tristate "CM3323E RGB color sensor"
	depends on I2C
	help
	  Say Y here to enable the CM3323E RGB Color Sensor.

config INPUT_TCS3400
	tristate "AMS TCS3400 RGB color sensor"
	depends on I2C
	help
	  Say Y here to enable the TCS3400 RGB Color Sensor.
```
